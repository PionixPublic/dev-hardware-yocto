## build/conf/bblayers.conf
```bitbake
# POKY_BBLAYERS_CONF_VERSION is increased each time build/conf/bblayers.conf
# changes incompatibly
POKY_BBLAYERS_CONF_VERSION = "2"

BBPATH = "${TOPDIR}"
BBFILES ?= ""

SOURCEROOT ?= "${@os.path.abspath(os.path.dirname(d.getVar('FILE', True)) + '/../../../source')}"
OEROOT := "${@os.path.abspath(os.path.dirname(d.getVar('FILE', True)) + '/..')}"

BBLAYERS ?= " \
  ${SOURCEROOT}/openembedded-core/meta \
  ${SOURCEROOT}/meta-yocto/meta-poky \
  ${SOURCEROOT}/meta-yocto/meta-yocto-bsp \
  ${SOURCEROOT}/meta-arm/meta-arm \
  ${SOURCEROOT}/meta-arm/meta-arm-toolchain \
  ${SOURCEROOT}/meta-raspberrypi \
  ${SOURCEROOT}/meta-openembedded/meta-oe \
  ${SOURCEROOT}/meta-openembedded/meta-multimedia \
  ${SOURCEROOT}/meta-openembedded/meta-networking \
  ${SOURCEROOT}/meta-openembedded/meta-python \
  ${SOURCEROOT}/meta-openembedded/meta-perl \
  ${SOURCEROOT}/meta-openembedded/meta-filesystems \
  ${SOURCEROOT}/meta-virtualization \
  ${SOURCEROOT}/meta-rauc \
  ${SOURCEROOT}/meta-flutter \
  ${SOURCEROOT}/meta-clang \
  ${SOURCEROOT}/meta-security \
  ${SOURCEROOT}/meta-security/meta-tpm \
  ${SOURCEROOT}/EVerest/yocto/wrynose/meta-everest \
  ${OEROOT}/../meta-belaybox \
  "
```

## meta-belaybox/conf/distro/belaybox.conf
```bitbake
require conf/distro/poky.conf

DISTRO = "belaybox"
DISTRO_NAME = "BelayBox (Pionix Pro Distro)"
DISTRO_VERSION = "1.0"

# Graphics features
DISTRO_FEATURES:append = " opengl multiarch wayland vulkan"
DISTRO_FEATURES:remove = " x11 mesa-demos"

# System features
DISTRO_FEATURES:append = " systemd usrmerge pam rauc security tpm debuginfod"
DISTRO_FEATURES_BACKFILL_CONSIDERED += "sysvinit"

# Init system configuration
VIRTUAL-RUNTIME_init_manager = "systemd"
VIRTUAL-RUNTIME_initscripts = "systemd-compat-units"
```
